## package/opensc/Config.in
```kconfig
config BR2_PACKAGE_OPENSC
	bool "opensc"
	depends on !BR2_STATIC_LIBS # dlopen()
	select BR2_PACKAGE_PCSC_LITE
	select BR2_PACKAGE_OPENSSL
	select BR2_PACKAGE_OPENSSL_FORCE_LIBOPENSSL
	help
	  OpenSC provides a set of libraries and utilities to work
	  with smart cards.

	  https://github.com/OpenSC/OpenSC/wiki
```
